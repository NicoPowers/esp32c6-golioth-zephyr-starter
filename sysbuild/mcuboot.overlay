/*
 * Copyright (c) 2025
 * SPDX-License-Identifier: MIT
 *
 * MCUboot overlay for 4MB flash configuration
 */

#include <espressif/esp32c6/esp32c6_wroom_n4.dtsi>
#include <espressif/partitions_0x0_default_4M.dtsi>

/ {
	chosen {
		zephyr,code-partition = &boot_partition;
	};
};
